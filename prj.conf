## CMakeLists.txt
```
cmake_minimum_required(VERSION 3.13.1)
macro(set_conf_file)
  if(EXISTS ${APPLICATION_SOURCE_DIR}/prj_${BOARD}.conf)
    set(CONF_FILE "${APPLICATION_SOURCE_DIR}/prj_${BOARD}.conf")
  elseif(EXISTS ${APPLICATION_SOURCE_DIR}/boards/${BOARD}.conf)
    set(CONF_FILE
      "prj.conf ${APPLICATION_SOURCE_DIR}/boards/${BOARD}.conf")
  else()
    set(CONF_FILE "prj.conf")
  endif()
endmacro()

include($ENV{ZEPHYR_BASE}/cmake/app/boilerplate.cmake NO_POLICY_SCOPE)
project(fan_controller)

FILE(GLOB app_sources src/*.c)
target_sources(app PRIVATE ${app_sources})
```

## prj.conf
```kconfig
CONFIG_NETWORKING=y
CONFIG_NET_SOCKETS=y
CONFIG_NET_TCP=y
CONFIG_NET_LOG=y

CONFIG_NET_IPV6_RA_RDNSS=y
CONFIG_NET_IF_UNICAST_IPV6_ADDR_COUNT=3
CONFIG_NET_IF_MCAST_IPV6_ADDR_COUNT=2

CONFIG_PRINTK=y
CONFIG_STDOUT_CONSOLE=y

# Enable IPv6 support
CONFIG_NET_IPV6=n
# Enable IPv4 support
CONFIG_NET_IPV4=y

# Enable the MQTT Lib
CONFIG_MQTT_LIB=y

CONFIG_NET_CONFIG_SETTINGS=y
CONFIG_NET_CONFIG_MY_IPV6_ADDR="2001:db8::1"
CONFIG_NET_CONFIG_PEER_IPV6_ADDR="2001:db8::2"

CONFIG_NET_CONFIG_MY_IPV4_ADDR="192.168.31.135"
CONFIG_NET_CONFIG_PEER_IPV4_ADDR="192.168.31.215"

CONFIG_MAIN_STACK_SIZE=2048

# For IPv6
CONFIG_NET_BUF_DATA_SIZE=256

# DNS
CONFIG_NET_SHELL=y
CONFIG_DNS_SERVER_IP_ADDRESSES=y
CONFIG_DNS_SERVER1="8.8.8.8"
CONFIG_DNS_RESOLVER=y

# buffer
CONFIG_SHELL_BACKEND_SERIAL_TX_RING_BUFFER_SIZE=120

CONFIG_ENTROPY_STM32_RNG=n
CONFIG_ENTROPY_GENERATOR=n
CONFIG_TEST_RANDOM_GENERATOR=y
```

## src/main.c
```c
/*
 * Copyright (c) 2017 Intel Corporation
 *
 * SPDX-License-Identifier: Apache-2.0
 */

#include <logging/log.h>
LOG_MODULE_REGISTER(fan_controller, LOG_LEVEL_DBG);

#include <zephyr.h>
#include <net/socket.h>
#include <net/mqtt.h>

#include <misc/printk.h>
#include <string.h>
#include <errno.h>

#include "config.h"
#include "oldmain.h"
#include "mqtt_helper.h"

#if defined(CONFIG_MQTT_LIB_TLS)

#include "test_certs.h"

#define TLS_SNI_HOSTNAME "localhost"
#define APP_CA_CERT_TAG 1
#define APP_PSK_TAG 2

static sec_tag_t m_sec_tags[] = {
#if defined(MBEDTLS_X509_CRT_PARSE_C) || defined(CONFIG_NET_SOCKETS_OFFLOAD)
		APP_CA_CERT_TAG,
#endif
#if defined(MBEDTLS_KEY_EXCHANGE__SOME__PSK_ENABLED)
		APP_PSK_TAG,
#endif
};

static int tls_init(void)
{
	int err = -EINVAL;

#if defined(MBEDTLS_X509_CRT_PARSE_C) || defined(CONFIG_NET_SOCKETS_OFFLOAD)
	err = tls_credential_add(APP_CA_CERT_TAG, TLS_CREDENTIAL_CA_CERTIFICATE,
				 ca_certificate, sizeof(ca_certificate));
	if (err < 0) {
		LOG_ERR("Failed to register public certificate: %d", err);
		return err;
	}
#endif

#if defined(MBEDTLS_KEY_EXCHANGE__SOME__PSK_ENABLED)
	err = tls_credential_add(APP_PSK_TAG, TLS_CREDENTIAL_PSK,
				 client_psk, sizeof(client_psk));
	if (err < 0) {
		LOG_ERR("Failed to register PSK: %d", err);
		return err;
	}

	err = tls_credential_add(APP_PSK_TAG, TLS_CREDENTIAL_PSK_ID,
				 client_psk_id, sizeof(client_psk_id) - 1);
	if (err < 0) {
		LOG_ERR("Failed to register PSK ID: %d", err);
	}
#endif

	return err;
}

#endif /* CONFIG_MQTT_LIB_TLS */

static void publisher(void)
{
	int i, rc;

	printk("attempting to connect: ");
	rc = try_to_connect(&client_ctx);
	PRINT_RESULT("try_to_connect", rc);
	SUCCESS_OR_EXIT(rc);

	i = 0;
	while (i++ < APP_MAX_ITERATIONS && connected) {
		rc = mqtt_ping(&client_ctx);
		PRINT_RESULT("mqtt_ping", rc);
		SUCCESS_OR_BREAK(rc);

		rc = process_mqtt_and_sleep(&client_ctx, APP_SLEEP_MSECS);
		SUCCESS_OR_BREAK(rc);

		rc = publish(&client_ctx, MQTT_QOS_0_AT_MOST_ONCE);
		PRINT_RESULT("mqtt_publish", rc);
		SUCCESS_OR_BREAK(rc);

		rc = process_mqtt_and_sleep(&client_ctx, APP_SLEEP_MSECS);
		SUCCESS_OR_BREAK(rc);

		rc = publish(&client_ctx, MQTT_QOS_1_AT_LEAST_ONCE);
		PRINT_RESULT("mqtt_publish", rc);
		SUCCESS_OR_BREAK(rc);

		rc = process_mqtt_and_sleep(&client_ctx, APP_SLEEP_MSECS);
		SUCCESS_OR_BREAK(rc);

		rc = publish(&client_ctx, MQTT_QOS_2_EXACTLY_ONCE);
		PRINT_RESULT("mqtt_publish", rc);
		SUCCESS_OR_BREAK(rc);

		rc = process_mqtt_and_sleep(&client_ctx, APP_SLEEP_MSECS);
		SUCCESS_OR_BREAK(rc);
	}

	rc = mqtt_disconnect(&client_ctx);
	PRINT_RESULT("mqtt_disconnect", rc);

	wait(APP_SLEEP_MSECS);
	rc = mqtt_input(&client_ctx);
	PRINT_RESULT("mqtt_input", rc);

	printk("\nBye!\n");
}

void main(void)
{
#if defined(CONFIG_MQTT_LIB_TLS)
	int rc;

	rc = tls_init();
	PRINT_RESULT("tls_init", rc);
#endif
	// original setup();
	setup();
	while (1) {
		// publisher();
		loop();
		k_sleep(5000);
	}
}
```

## src/config.h
```c
/*
 * Copyright (c) 2017 Intel Corporation
 *
 * SPDX-License-Identifier: Apache-2.0
 */

#ifndef __CONFIG_H__
#define __CONFIG_H__

#ifdef CONFIG_NET_CONFIG_SETTINGS
#ifdef CONFIG_NET_IPV6
#define ZEPHYR_ADDR CONFIG_NET_CONFIG_MY_IPV6_ADDR
#define SERVER_ADDR CONFIG_NET_CONFIG_PEER_IPV6_ADDR
#else
#define ZEPHYR_ADDR CONFIG_NET_CONFIG_MY_IPV4_ADDR
#define SERVER_ADDR CONFIG_NET_CONFIG_PEER_IPV4_ADDR
#endif
#else
#ifdef CONFIG_NET_IPV6
#define ZEPHYR_ADDR "2001:db8::1"
#define SERVER_ADDR "2001:db8::2"
#else
#define ZEPHYR_ADDR "192.168.31.127"
#define SERVER_ADDR "192.168.31.215"
#endif
#endif

#if defined(CONFIG_MQTT_LIB_SOCKS)
#define SOCKS5_PROXY_ADDR SERVER_ADDR
#define SOCKS5_PROXY_PORT 1080
#endif

#ifdef CONFIG_MQTT_LIB_TLS
#define SERVER_PORT 8883
#else
#define SERVER_PORT 1883
#endif

#define APP_SLEEP_MSECS 500
#define APP_TX_RX_TIMEOUT 300
#define APP_NET_INIT_TIMEOUT 10000

#define APP_CONNECT_TRIES 10

#define APP_MAX_ITERATIONS 100

#define APP_MQTT_BUFFER_SIZE 128

#define MQTT_CLIENTID "zephyr_publisher"

/* Set the following to 1 to enable the Bluemix topic format */
#define APP_BLUEMIX_TOPIC 0

/* These are the parameters for the Bluemix topic format */
#if APP_BLUEMIX_TOPIC
#define BLUEMIX_DEVTYPE "sensor"
#define BLUEMIX_DEVID "carbon"
#define BLUEMIX_EVENT "status"
#define BLUEMIX_FORMAT "json"
#endif

// fan config
#define fan_controlledByMQTT
#define useMQTT

// QOS
#define QOS MQTT_QOS_1_AT_LEAST_ONCE

// initial pwm fan speed on startup (0 <= value <= 255)
#define INITIALPWMVALUE 120

// delta used when manually increasing or decreasing pwm
#define PWMSTEP 10

// fanTacho
#define TACHOUPDATECYCLE \
  1000  // how often tacho speed shall be determined, in milliseconds
#define NUMBEROFINTERRUPSINONESINGLEROTATION \
  2  // Number of interrupts ESP32 sees on tacho signal on a single fan
     // rotation. All the fans I've seen trigger two interrups.

// home assistant
#define useHomeassistantMQTTDiscovery

#define UNIQUE_DEVICE_FRIENDLYNAME "Fan Controller"
#define UNIQUE_DEVICE_NAME "fan_controller"

#define HASSSTATUSTOPIC "homeassistant/status" // can be "online" and "offline"
#define HASSSTATUSONLINEPAYLOAD "online"
#define HASSSTATUSOFFLINEPAYLOAD "offline"

#define HOMEASSISTANTDEVICE                         \
  "\"dev\":{\"name\":\"" UNIQUE_DEVICE_FRIENDLYNAME \
  "\", \"model\":\"" UNIQUE_DEVICE_NAME             \
  "\", \"identifiers\":[\"" UNIQUE_DEVICE_NAME      \
  "\"], \"manufacturer\":\"KlausMu\"}"

#define HASSFANDISCOVERYTOPIC "homeassistant/fan/" UNIQUE_DEVICE_NAME "/config"
#define HASSFANDISCOVERYPAYLOAD                                               \
  "{\"name\":null,            \"unique_id\":\"" UNIQUE_DEVICE_NAME            \
  "\",             \"object_id\":\"" UNIQUE_DEVICE_NAME                       \
  "\",             \"~\":\"" UNIQUE_DEVICE_NAME                               \
  "\", \"icon\":\"mdi:fan\", \"command_topic\":\"~/cmnd/MODE\", "             \
  "\"state_topic\":\"~/stat/MODE\", \"payload_on\": \"fan_only\", "           \
  "\"payload_off\": \"off\", \"percentage_state_topic\": \"~/stat/FANPWM\", " \
  "\"percentage_command_topic\": \"~/cmnd/FANPWM\", \"speed_range_min\": 1, " \
  "\"speed_range_max\": "                                                     \
  "255,\"availability_topic\":\"~/stat/STATUS\", " HOMEASSISTANTDEVICE "}"

#define HASSPWMSENSORDISCOVERYTOPIC \
  "homeassistant/sensor/" UNIQUE_DEVICE_NAME "/pwm/config"
#define HASSPWMSENSORDISCOVERYPAYLOAD                                          \
  "{\"name\":\"PWM\",         \"unique_id\":\"" UNIQUE_DEVICE_NAME             \
  "_PWM\",         \"object_id\":\"" UNIQUE_DEVICE_NAME                        \
  "_PWM\",         \"~\":\"" UNIQUE_DEVICE_NAME                                \
  "\", \"state_topic\":\"~/tele/STATE2\", \"value_template\":\"{{ "            \
  "value_json.pwm }}\",                                                      " \
  "                                      \"state_class\":\"measurement\", "    \
  "\"expire_after\": \"30\",                                                 " \
  "                                                                          " \
  "                                                                          " \
  "                                                                          " \
  "              " HOMEASSISTANTDEVICE "}"
#define HASSRPMSENSORDISCOVERYTOPIC \
  "homeassistant/sensor/" UNIQUE_DEVICE_NAME "/rpm/config"
#define HASSRPMSENSORDISCOVERYPAYLOAD                                          \
  "{\"name\":\"RPM\",         \"unique_id\":\"" UNIQUE_DEVICE_NAME             \
  "_RPM\",         \"object_id\":\"" UNIQUE_DEVICE_NAME                        \
  "_RPM\",         \"~\":\"" UNIQUE_DEVICE_NAME                                \
  "\", \"state_topic\":\"~/tele/STATE2\", \"value_template\":\"{{ "            \
  "value_json.rpm }}\",                                                      " \
  "                                      \"state_class\":\"measurement\", "    \
  "\"expire_after\": \"30\",                                                 " \
  "                                                                          " \
  "                                                                          " \
  "                                                                          " \
  "              " HOMEASSISTANTDEVICE "}"

#define WAITAFTERHAISONLINEUNTILDISCOVERYWILLBESENT 1000
#define HASSFANSTATUSTOPIC UNIQUE_DEVICE_NAME "/stat/STATUS"

#define MQTTCMNDTARGETTEMP UNIQUE_DEVICE_NAME "/cmnd/TARGETTEMP"
#define MQTTSTATTARGETTEMP UNIQUE_DEVICE_NAME "/stat/TARGETTEMP"
#define MQTTCMNDACTUALTEMP UNIQUE_DEVICE_NAME "/cmnd/ACTUALTEMP"
#define MQTTSTATACTUALTEMP UNIQUE_DEVICE_NAME "/stat/ACTUALTEMP"
#define MQTTCMNDFANPWM UNIQUE_DEVICE_NAME "/cmnd/FANPWM"
#define MQTTSTATFANPWM UNIQUE_DEVICE_NAME "/stat/FANPWM"
// https://www.home-assistant.io/integrations/climate.mqtt/#mode_command_topic
// https://www.home-assistant.io/integrations/climate.mqtt/#mode_state_topic
// note: it is not guaranteed that fan stops if pwm is set to 0
#define MQTTCMNDFANMODE                                                        \
  UNIQUE_DEVICE_NAME "/cmnd/MODE" // can be "off" and "fan_only"
#define MQTTSTATFANMODE UNIQUE_DEVICE_NAME "/stat/MODE"
#define MQTTFANMODEOFFPAYLOAD "off"
#define MQTTFANMODEFANONLYPAYLOAD "fan_only"

#if defined(useOTAUpdate)
#define MQTTCMNDOTA UNIQUE_DEVICE_NAME "/cmnd/OTA"
#endif

#ifdef useTemperatureSensorBME280
#define MQTTTELESTATE1 UNIQUE_DEVICE_NAME "/tele/STATE1"
#endif
#define MQTTTELESTATE2 UNIQUE_DEVICE_NAME "/tele/STATE2"
#define MQTTTELESTATE3 UNIQUE_DEVICE_NAME "/tele/STATE3"
#define MQTTTELESTATE4 UNIQUE_DEVICE_NAME "/tele/STATE4"


/////////////////////
// missing functions
#define millis() k_uptime_get_32()

#endif
```

## src/fanPWM.c
```c
// #include <Arduino.h>
// #include <esp32-hal.h>
// #include <esp32-hal-ledc.h>
#include "config.h"
// #include "log.h"
#include "mqtt_helper.h"
#include "tft.h"
#include <logging/log.h>
LOG_MODULE_DECLARE(fan_controller, LOG_LEVEL_DBG);

int pwmValue = 0;
bool modeIsOff = false;
void updateMQTT_Screen_withNewPWMvalue(int aPWMvalue, bool force);
void updateMQTT_Screen_withNewMode(bool aModeIsOff, bool force);

// https://randomnerdtutorials.com/esp32-pwm-arduino-ide/
void initPWMfan(void){
  // configure LED PWM functionalitites
  // ledcSetup(PWMCHANNEL, PWMFREQ, PWMRESOLUTION);
  // attach the channel to the GPIO to be controlled
  // ledcAttachPin(PWMPIN,N PWMCHANEL);

  pwmValue = INITIALPWMVALUE;
  updateMQTT_Screen_withNewPWMvalue(pwmValue, true);
  updateMQTT_Screen_withNewMode(false, true);

  LOG_INF("  Fan PWM sucessfully initialized.\r\n");
}

void updateFanSpeed(void){
  // ledcWrite(PWMCHANNEL, pwmValue);
  LOG_INF("Update Fan speed %d", pwmValue);
}

void updateMQTT_Screen_withNewPWMvalue(int aPWMvalue, bool force) {
  // note: it is not guaranteed that fan stops if pwm is set to 0
  if (modeIsOff) {aPWMvalue = 0;}
  if ((pwmValue != aPWMvalue) || force) {
    pwmValue = aPWMvalue;
    if (pwmValue < 0) {pwmValue = 0;};
    if (pwmValue > 255) {pwmValue = 255;};
    updateFanSpeed();
    #ifdef useMQTT
    mqtt_publish_stat_fanPWM();
    mqtt_publish_tele();
    #endif
    draw_screen();
  }
}

void updateMQTT_Screen_withNewMode(bool aModeIsOff, bool force) {
  if ((modeIsOff != aModeIsOff) || force) {
    modeIsOff = aModeIsOff;
    #ifdef useMQTT
    mqtt_publish_stat_mode();
    #endif
    switchOff_screen(modeIsOff);
  }
  if (modeIsOff) {
    updateMQTT_Screen_withNewPWMvalue(0, true);
  } else {
    updateMQTT_Screen_withNewPWMvalue(INITIALPWMVALUE, true);
  }
}

#ifndef useAutomaticTemperatureControl
void incFanSpeed(void){
  int newPWMValue = min(pwmValue+PWMSTEP, 255);
  updateMQTT_Screen_withNewPWMvalue(newPWMValue, false);
}
void decFanSpeed(void){
  int newPWMValue = max(pwmValue-PWMSTEP, 0);
  updateMQTT_Screen_withNewPWMvalue(newPWMValue, false);
}
#endif

int getPWMvalue(){
  return pwmValue;
}

bool getModeIsOff(void) {
  return modeIsOff;
}
```

## src/fanPWM.h
```c
#include <stdbool.h>

void initPWMfan(void);
void updateMQTT_Screen_withNewPWMvalue(int aPWMvalue, bool force);
void updateMQTT_Screen_withNewMode(bool aModeIsOff, bool force);
#ifndef useAutomaticTemperatureControl
void incFanSpeed(void);
void decFanSpeed(void);
#endif
int getPWMvalue();
bool getModeIsOff(void);
```

## src/fanTacho.c
```c
// #include <Arduino.h>
// #include <esp32-hal.h>
// #include <pins_arduino.h>
#include "config.h"
#include <logging/log.h>
LOG_MODULE_DECLARE(fan_controller, LOG_LEVEL_DBG);

static volatile int counter_rpm = 0;
int last_rpm = 0;
unsigned long millisecondsLastTachoMeasurement = 0;

// Interrupt counting every rotation of the fan
// https://desire.giesecke.tk/index.php/2018/01/30/change-global-variables-from-isr/
void rpm_fan() {
  counter_rpm++;
}

void initTacho(void) {
  // pinMode(TACHOPIN, INPUT);
  // digitalWrite(TACHOPIN, HIGH);
  // attachInterrupt(digitalPinToInterrupt(TACHOPIN), rpm_fan, FALLING);
  LOG_INF("  Fan tacho detection sucessfully initialized.");
}

void updateTacho(void) {
  // start of tacho measurement
  if ((unsigned long)(millis() - millisecondsLastTachoMeasurement) >= TACHOUPDATECYCLE)
  { 
    // detach interrupt while calculating rpm
    // detachInterrupt(digitalPinToInterrupt(TACHOPIN)); 
    // calculate rpm
    last_rpm = counter_rpm * ((float)60 / (float)NUMBEROFINTERRUPSINONESINGLEROTATION) * ((float)1000 / (float)TACHOUPDATECYCLE);
    LOG_INF("fan rpm = %d", last_rpm);

    // reset counter
    counter_rpm = 0; 
    // store milliseconds when tacho was measured the last time
    millisecondsLastTachoMeasurement = millis();

    // attach interrupt again
    // attachInterrupt(digitalPinToInterrupt(TACHOPIN), rpm_fan, FALLING);
  }
}
```

## src/mqtt_helper.c
```c
#include <logging/log.h>
LOG_MODULE_DECLARE(fan_controller, LOG_LEVEL_DBG);

// user include
#include <stdio.h>
#include <string.h>

#include "config.h"
#include "fanPWM.h"
#include "fanTacho.h"
#include "mqtt_helper.h"
#include "sensorBME280.h"
#include "temperatureController.h"
#include "tft.h"

#ifdef useMQTT
// https://randomnerdtutorials.com/esp32-mqtt-publish-subscribe-arduino-ide/
// https://github.com/knolleary/pubsubclient
// https://gist.github.com/igrr/7f7e7973366fc01d6393

unsigned long reconnectInterval = 5000;
// in order to do reconnect immediately ...
unsigned long lastReconnectAttempt = 0;
#ifdef useHomeassistantMQTTDiscovery
unsigned long timerStartForHAdiscovery = 1;
#endif

char *itoa(int num, char *str, int radix) { /*索引表*/
  char index[] = "0123456789ABCDEF";
  unsigned unum; /*中间变量*/
  int i = 0, j, k;
  /*确定unum的值*/
  if (radix == 10 && num < 0) /*十进制负数*/
  {
    unum = (unsigned)-num;
    str[i++] = '-';
  } else
    unum = (unsigned)num; /*其他情况*/
  /*转换*/
  do {
    str[i++] = index[unum % (unsigned)radix];
    unum /= radix;
  } while (unum);
  str[i] = '\0';
  /*逆序*/
  if (str[0] == '-')
    k = 1; /*十进制负数*/
  else
    k = 0;

  for (j = k; j <= (i - 1) / 2; j++) {
    char temp;
    temp = str[j];
    str[j] = str[i - 1 + k - j];
    str[i - 1 + k - j] = temp;
  }
  return str;
}

// zephyr mqtt

static void prepare_fds(struct mqtt_client *client) {
  if (client->transport.type == MQTT_TRANSPORT_NON_SECURE) {
    fds[0].fd = client->transport.tcp.sock;
  }
#if defined(CONFIG_MQTT_LIB_TLS)
  else if (client->transport.type == MQTT_TRANSPORT_SECURE) {
    fds[0].fd = client->transport.tls.sock;
  }
#endif

  fds[0].events = ZSOCK_POLLIN;
  nfds = 1;
}

static void clear_fds(void) { nfds = 0; }

static void wait(int timeout) {
  if (nfds > 0) {
    if (poll(fds, nfds, timeout) < 0) {
      printk("poll error: %d\n", errno);
    }
  }
}

int process_mqtt_and_sleep(struct mqtt_client *client, int timeout) {
  s64_t remaining = timeout;
  s64_t start_time = k_uptime_get();
  int rc;

  while (remaining > 0 && connected) {
    wait(remaining);

    rc = mqtt_live(client);
    if (rc != 0) {
      PRINT_RESULT("mqtt_live", rc);
      return rc;
    }

    rc = mqtt_input(client);
    if (rc != 0) {
      PRINT_RESULT("mqtt_input", rc);
      return rc;
    }

    remaining = timeout + start_time - k_uptime_get();
  }

  return 0;
}

void client_init(struct mqtt_client *client) {
  mqtt_client_init(client);

  broker_init();

  /* MQTT client configuration */
  client->broker = &broker;
  client->evt_cb = mqtt_evt_handler;
  client->client_id.utf8 = (u8_t *)MQTT_CLIENTID;
  client->client_id.size = strlen(MQTT_CLIENTID);
  client->password = NULL;
  client->user_name = NULL;
  client->protocol_version = MQTT_VERSION_3_1_1;

  /* MQTT buffers configuration */
  client->rx_buf = rx_buffer;
  client->rx_buf_size = sizeof(rx_buffer);
  client->tx_buf = tx_buffer;
  client->tx_buf_size = sizeof(tx_buffer);

  /* MQTT transport configuration */
#if defined(CONFIG_MQTT_LIB_TLS)
  client->transport.type = MQTT_TRANSPORT_SECURE;

  struct mqtt_sec_config *tls_config = &client->transport.tls.config;

  tls_config->peer_verify = 2;
  tls_config->cipher_list = NULL;
  tls_config->sec_tag_list = m_sec_tags;
  tls_config->sec_tag_count = ARRAY_SIZE(m_sec_tags);
#if defined(MBEDTLS_X509_CRT_PARSE_C) || defined(CONFIG_NET_SOCKETS_OFFLOAD)
  tls_config->hostname = TLS_SNI_HOSTNAME;
#else
  tls_config->hostname = NULL;
#endif

#else
#if defined(CONFIG_MQTT_LIB_SOCKS)
  client->transport.type = MQTT_TRANSPORT_SOCKS;
  client->transport.socks5.proxy = &socks5_proxy;
#else
  client->transport.type = MQTT_TRANSPORT_NON_SECURE;
#endif
#endif
}

static void broker_init(void) {
#if defined(CONFIG_NET_IPV6)
  struct sockaddr_in6 *broker6 = (struct sockaddr_in6 *)&broker;

  broker6->sin6_family = AF_INET6;
  broker6->sin6_port = htons(SERVER_PORT);
  inet_pton(AF_INET6, SERVER_ADDR, &broker6->sin6_addr);

#if defined(CONFIG_MQTT_LIB_SOCKS)
  struct sockaddr_in6 *proxy6 = (struct sockaddr_in6 *)&socks5_proxy;

  proxy6->sin6_family = AF_INET6;
  proxy6->sin6_port = htons(SOCKS5_PROXY_PORT);
  inet_pton(AF_INET6, SOCKS5_PROXY_ADDR, &proxy6->sin6_addr);
#endif
#else
  struct sockaddr_in *broker4 = (struct sockaddr_in *)&broker;

  broker4->sin_family = AF_INET;
  broker4->sin_port = htons(SERVER_PORT);
  inet_pton(AF_INET, SERVER_ADDR, &broker4->sin_addr);

#if defined(CONFIG_MQTT_LIB_SOCKS)
  struct sockaddr_in *proxy4 = (struct sockaddr_in *)&socks5_proxy;

  proxy4->sin_family = AF_INET;
  proxy4->sin_port = htons(SOCKS5_PROXY_PORT);
  inet_pton(AF_INET, SOCKS5_PROXY_ADDR, &proxy4->sin_addr);
#endif
#endif
}

/* In this routine we block until the connected variable is 1 */
static int try_to_connect(struct mqtt_client *client) {
  int rc, i = 0;

  while (i++ < APP_CONNECT_TRIES && !connected) {
    client_init(client);

    rc = mqtt_connect(client);
    if (rc != 0) {
      PRINT_RESULT("mqtt_connect", rc);
      k_sleep(APP_SLEEP_MSECS);
      continue;
    }

    prepare_fds(client);

    wait(APP_SLEEP_MSECS);
    mqtt_input(client);

    if (!connected) {
      mqtt_abort(client);
    }
  }

  if (connected) {
    return 0;
  }

  return -EINVAL;
}

void callback(char *topic, char *payload, unsigned int length);

void mqtt_evt_handler(struct mqtt_client *const client,
                      const struct mqtt_evt *evt) {
  int err;
  struct mqtt_puback_param puback;

  switch (evt->type) {
    case MQTT_EVT_CONNACK:
      if (evt->result != 0) {
        printk("MQTT connect failed %d\n", evt->result);
        break;
      }

      connected = true;
      printk("[%s:%d] MQTT client connected!\n", __func__, __LINE__);

      break;

    case MQTT_EVT_DISCONNECT:
      printk("[%s:%d] MQTT client disconnected %d\n", __func__, __LINE__,
             evt->result);

      connected = false;
      clear_fds();

      break;

    case MQTT_EVT_PUBACK:
      if (evt->result != 0) {
        printk("MQTT PUBACK error %d\n", evt->result);
        break;
      }

      printk("[%s:%d] PUBACK packet id: %u\n", __func__, __LINE__,
             evt->param.puback.message_id);

      break;

    case MQTT_EVT_PUBREC:
      if (evt->result != 0) {
        printk("MQTT PUBREC error %d\n", evt->result);
        break;
      }

      printk("[%s:%d] PUBREC packet id: %u\n", __func__, __LINE__,
             evt->param.pubrec.message_id);

      const struct mqtt_pubrel_param rel_param = {
          .message_id = evt->param.pubrec.message_id};

      err = mqtt_publish_qos2_release(client, &rel_param);
      if (err != 0) {
        printk("Failed to send MQTT PUBREL: %d\n", err);
      }

      break;

    case MQTT_EVT_PUBCOMP:
      if (evt->result != 0) {
        printk("MQTT PUBCOMP error %d\n", evt->result);
        break;
      }

      printk("[%s:%d] PUBCOMP packet id: %u\n", __func__, __LINE__,
             evt->param.pubcomp.message_id);

      break;

    case MQTT_EVT_PUBLISH: {
      int topic_len = evt->param.publish.message.topic.topic.size;
      LOG_INF("topic len %d", topic_len);
      if (topic_len > 25) {
        LOG_ERR("too long topic %d",
                topic_len);
        break;
      } else {
        size_t i = 0;
        for (; i < topic_len; i++) {
          topic[i] = (char)evt->param.publish.message.topic.topic.utf8[i];
        }
        topic[i] = '\0';
      }
      int len = evt->param.publish.message.payload.len;
      if (len > 50) {
        LOG_ERR("too long payload len %d", len);
        break;
      }
      int bytes_read;
      LOG_INF("MQTT publish received %d, %d bytes", evt->result, len);
      // LOG_INF("topic %s", topic);
      LOG_INF("   id: %d, qos: %d", evt->param.publish.message_id,
              evt->param.publish.message.topic.qos);

      while (len) {
        bytes_read = mqtt_read_publish_payload(&client_ctx, packet, len);
        if (bytes_read < 0 && bytes_read != -EAGAIN) {
          LOG_ERR("failure to read payload");
          break;
        }
        if (bytes_read < len) {
          LOG_ERR("not read payload in one read read:%d all:%d", bytes_read,
                  len);
          break;
        }
      }
      packet[len] = '\0';
      if (evt->param.publish.message.topic.qos == MQTT_QOS_1_AT_LEAST_ONCE) {
        puback.message_id = evt->param.publish.message_id;
        mqtt_publish_qos1_ack(&client_ctx, &puback);
      }
      callback(topic, packet, len);
      break;
    }

    default:
      break;
  }
}

void mqtt_setup() {
  // #ifdef useHomeassistantMQTTDiscovery
  //   // Set buffer size to allow hass discovery payload
  //   mqttClient.setBufferSize(1280);
  // #endif
  return;
}

void mqtt_loop() {
  if (connected) {
    unsigned long currentMillis = millis();
    if ((currentMillis - lastReconnectAttempt) > reconnectInterval) {
      lastReconnectAttempt = currentMillis;
      // Attempt to reconnect
      checkMQTTconnection();
    }
  }

  if (connected) {
    process_mqtt_and_sleep(&client_ctx, APP_SLEEP_MSECS);
  }
}

bool checkMQTTconnection() {
  if (connected) {
    return true;
  } else {
    // try to connect to mqtt server
    // In case of Home Assistant, connect with last will to the broker to set
    // the device offline when the esp32 fan controller is swtiched off
    if (!try_to_connect(&client_ctx)) {
      LOG_INF("Successfully connected to MQTT broker");

      // subscribes to messages with given topic.
      // Callback function will be called 1. in client.loop() 2. when sending
      // a message
      int err = 0;
      // 1.
      subs_topic.topic.utf8 = MQTTCMNDTARGETTEMP;
      // -1 because dif between sizeof and strlen
      subs_topic.topic.size = sizeof(MQTTCMNDACTUALTEMP) - 1;
      subs_topic.qos = MQTT_QOS_1_AT_LEAST_ONCE;
      subs_list.list = &subs_topic;
      subs_list.list_count = 1;
      subs_list.message_id = current_msg_id++;
      err = mqtt_subscribe(&client_ctx, &subs_list);
      if (err) {
        LOG_ERR("Failed to subscribe %d topic: %s", err, MQTTCMNDTARGETTEMP);
      }
      // 2.
      subs_topic.topic.utf8 = MQTTCMNDACTUALTEMP;
      subs_topic.topic.size = sizeof(MQTTCMNDACTUALTEMP) - 1;
      subs_topic.qos = MQTT_QOS_1_AT_LEAST_ONCE;
      subs_list.list = &subs_topic;
      subs_list.list_count = 1;
      subs_list.message_id = current_msg_id++;
      err = mqtt_subscribe(&client_ctx, &subs_list);
      if (err) {
        LOG_ERR("Failed to subscribe %d topic: %s", err, MQTTCMNDACTUALTEMP);
      }
      // 3.
      subs_topic.topic.utf8 = MQTTCMNDFANPWM;
      subs_topic.topic.size = sizeof(MQTTCMNDFANPWM) - 1;
      subs_topic.qos = MQTT_QOS_1_AT_LEAST_ONCE;
      subs_list.list = &subs_topic;
      subs_list.list_count = 1;
      subs_list.message_id = current_msg_id++;
      err = mqtt_subscribe(&client_ctx, &subs_list);
      if (err) {
        LOG_ERR("Failed to subscribe %d topic: %s", err, MQTTCMNDFANPWM);
      }
      // 4.
      subs_topic.topic.utf8 = MQTTCMNDFANMODE;
      subs_topic.topic.size = sizeof(MQTTCMNDFANMODE) - 1;
      subs_topic.qos = MQTT_QOS_1_AT_LEAST_ONCE;
      subs_list.list = &subs_topic;
      subs_list.list_count = 1;
      subs_list.message_id = current_msg_id++;
      err = mqtt_subscribe(&client_ctx, &subs_list);
      if (err) {
        LOG_ERR("Failed to subscribe %d topic: %s", err, MQTTCMNDFANMODE);
      }

      // mqttClient.subscribe(MQTTCMNDTARGETTEMP);
      // mqttClient.subscribe(MQTTCMNDACTUALTEMP);
      // mqttClient.subscribe(MQTTCMNDFANPWM);
      // mqttClient.subscribe(MQTTCMNDFANMODE);
#if defined(useHomeassistantMQTTDiscovery)
      // 5.
      subs_topic.topic.utf8 = HASSSTATUSTOPIC;
      subs_topic.topic.size = sizeof(HASSSTATUSTOPIC) - 1;
      subs_topic.qos = MQTT_QOS_1_AT_LEAST_ONCE;
      subs_list.list = &subs_topic;
      subs_list.list_count = 1;
      subs_list.message_id = current_msg_id++;
      err = mqtt_subscribe(&client_ctx, &subs_list);
      if (err) {
        LOG_ERR("Failed to subscribe %d topic: %s", err, HASSSTATUSTOPIC);
      }
      // mqttClient.subscribe(HASSSTATUSTOPIC);
      //  if we successfully connected or reconnected to the mqtt server, send
      //  HA discovery
      timerStartForHAdiscovery = millis();
#endif
#if defined(useOTAUpdate)
      // 6.
      subs_topic.topic.utf8 = MQTTCMNDOTA;
      subs_topic.topic.size = sizeof(MQTTCMNDOTA) - 1;
      subs_topic.qos = MQTT_QOS_1_AT_LEAST_ONCE;
      subs_list.list = &subs_topic;
      subs_list.list_count = 1;
      subs_list.message_id = current_msg_id++;
      err = mqtt_subscribe(&client_ctx, &subs_list);
      if (err) {
        LOG_ERR("Failed to subscribe %d topic: %s", err, MQTTCMNDACTUALTEMP);
      }
      // mqttClient.subscribe(MQTTCMNDOTA);
#endif
    } else {
      LOG_INF(
          "  MQTT connection failed. Will try later "
          "...");
      return false;
    }
  }
}

bool publishMQTTMessage(const char *topic, const char *payload) {
  if (checkMQTTconnection()) {
    //  LOG_INF("Sending mqtt payload to topic \"%s\": %s", topic, payload);
    struct mqtt_publish_param param;

    param.message.topic.qos = QOS;
    param.message.topic.topic.utf8 = (u8_t *)topic;
    param.message.topic.topic.size = strlen(topic);
    param.message.payload.data = payload;
    param.message.payload.len = strlen(payload);
    param.message_id = current_msg_id++;
    param.dup_flag = 0;
    param.retain_flag = 0;
    if (!mqtt_publish(&client_ctx, &param)) {
      // LOG_INF("Publish ok");
      return true;
    } else {
      LOG_INF("Publish failed");
    }
  } else {
    LOG_INF(
        "  Cannot publish mqtt message, because checkMQTTconnection failed "
        "(WiFi or mqtt is not connected)");
  }
  return false;
}

bool mqtt_publish_stat_targetTemp() {
  char str[10];
  sprintf(str, "%.2f", getTargetTemperature());
  return publishMQTTMessage(MQTTSTATTARGETTEMP, str);
};
bool mqtt_publish_stat_actualTemp() {
  char str[10];
  sprintf(str, "%.2f", getActualTemperature());
  return publishMQTTMessage(MQTTSTATACTUALTEMP, str);
};
bool mqtt_publish_stat_fanPWM() {
  char str[10];
  sprintf(str, "%.2f", getPWMvalue());
  return publishMQTTMessage(MQTTSTATFANPWM, str);
};
bool mqtt_publish_stat_mode() {
  return publishMQTTMessage(MQTTSTATFANMODE, getModeIsOff()
                                                 ? MQTTFANMODEOFFPAYLOAD
                                                 : MQTTFANMODEFANONLYPAYLOAD);
};
#ifdef useShutdownButton
bool mqtt_publish_shutdown() {
  return publishMQTTMessage(MQTTCMNDSHUTDOWNTOPIC, MQTTCMNDSHUTDOWNPAYLOAD);
};
#endif

#ifdef useHomeassistantMQTTDiscovery
bool mqtt_publish_hass_discovery() {
  LOG_INF("Will send HA discovery now.");
  bool error = false;
#ifdef useAutomaticTemperatureControl
  error = !publishMQTTMessage(HASSCLIMATEDISCOVERYTOPIC,
                              HASSCLIMATEDISCOVERYPAYLOAD);
#else
  error = !publishMQTTMessage(HASSFANDISCOVERYTOPIC, HASSFANDISCOVERYPAYLOAD);
#endif
#ifdef useTemperatureSensorBME280
  error = error || !publishMQTTMessage(HASSHUMIDITYSENSORDISCOVERYTOPIC,
                                       HASSHUMIDITYSENSORDISCOVERYPAYLOAD);
  error = error || !publishMQTTMessage(HASSTEMPERATURESENSORDISCOVERYTOPIC,
                                       HASSTEMPERATURESENSORDISCOVERYPAYLOAD);
  error = error || !publishMQTTMessage(HASSPRESSURESENSORDISCOVERYTOPIC,
                                       HASSPRESSURESENSORDISCOVERYPAYLOAD);
  error = error || !publishMQTTMessage(HASSALTITUDESENSORDISCOVERYTOPIC,
                                       HASSALTITUDESENSORDISCOVERYPAYLOAD);
#endif
  error = error || !publishMQTTMessage(HASSPWMSENSORDISCOVERYTOPIC,
                                       HASSPWMSENSORDISCOVERYPAYLOAD);
  error = error || !publishMQTTMessage(HASSRPMSENSORDISCOVERYTOPIC,
                                       HASSRPMSENSORDISCOVERYPAYLOAD);

  if (!error) {
    // delay(1000);
    k_sleep(1000);
  }
  // publish that we are online. Remark: offline is sent via last will
  // retained message
  error = error || !publishMQTTMessage(HASSFANSTATUSTOPIC, "");
  error =
      error || !publishMQTTMessage(HASSFANSTATUSTOPIC, HASSSTATUSONLINEPAYLOAD);

  if (!error) {
    // delay(1000);
    k_sleep(1000);
  }
  // MODE????

  // that's not really part of the discovery message, but this enables the
  // climate slider in HA and immediately provides all values
  error = error || !mqtt_publish_stat_targetTemp();
  error = error || !mqtt_publish_stat_actualTemp();
  error = error || !mqtt_publish_stat_fanPWM();
  error = error || !mqtt_publish_stat_mode();
  error = error || !mqtt_publish_tele();
  if (!error) {
    // will not resend discovery as long as timerStartForHAdiscovery == 0
    LOG_INF(
        "Will set timer to 0 now, this means I will not send discovery "
        "again.");
    timerStartForHAdiscovery = 0;
  } else {
    LOG_INF("Some error occured while sending discovery. Will try again.");
  }
  return !error;
}
#endif

bool mqtt_publish_tele() {
  bool error = false;
  // maximum message length 128 Byte
  char payload[64] = "";
// BME280
#ifdef useTemperatureSensorBME280
  payload += "{\"ActTemp\":";
  payload += lastTempSensorValues[0];
  payload += ",\"pres\":";
  payload += lastTempSensorValues[1];
  payload += ",\"alt\":";
  payload += lastTempSensorValues[2];
  payload += ",\"hum\":";
  payload += lastTempSensorValues[3];
  payload += ",\"TargTemp\":";
  payload += getTargetTemperature();
  payload += "}";
  error = !publishMQTTMessage(MQTTTELESTATE1, payload.c_str());
#endif

  // Fan
  char str[10];
  memset(payload, '\0', sizeof(payload));
  strcat(payload, "{\"rpm\":");
  strcat(payload, itoa(last_rpm, str, 10));
  memset(str, '\0', sizeof(str));
  strcat(payload, ",\"pwm\":");
  strcat(payload, itoa(getPWMvalue(), str, 10));
  strcat(payload, "}");
  error = error || !publishMQTTMessage(MQTTTELESTATE2, payload);

  // WiFi
  // payload = "";
  // payload += "{\"wifiRSSI\":";
  // payload += WiFi.RSSI();
  // payload += ",\"wifiChan\":";
  // payload += WiFi.channel();
  // payload += ",\"wifiSSID\":";
  // payload += WiFi.SSID();
  // payload += ",\"wifiBSSID\":";
  // payload += WiFi.BSSIDstr();
  // #if defined(WIFI_KNOWN_APS)
  // payload += ",\"wifiAP\":";
  // payload += accessPointName;
  // #endif
  // payload += ",\"IP\":";
  // payload += WiFi.localIP().toString();
  // payload += "}";
  // error = error || !publishMQTTMessage(MQTTTELESTATE3, payload.c_str());

  // ESP32 stats
  // payload = "";
  // payload += "{\"up\":";
  // payload += String(millis());
  // payload += ",\"heapSize\":";
  // payload += String(ESP.getHeapSize());
  // payload += ",\"heapFree\":";
  // payload += String(ESP.getFreeHeap());
  // payload += ",\"heapMin\":";
  // payload += String(ESP.getMinFreeHeap());
  // payload += ",\"heapMax\":";
  // payload += String(ESP.getMaxAllocHeap());
  // payload += "}";
  // error = error || !publishMQTTMessage(MQTTTELESTATE4, payload.c_str());

  return !error;
}

void callback(char *topic, char *payload, unsigned int length) {
  // handle message arrived
  // std::string strPayload(reinterpret_cast<const char *>(payload), length);

  LOG_INF("MQTT message arrived [%s] %s", topic, payload);

  if (!strcmp(topic, MQTTCMNDTARGETTEMP)) {
#ifdef useAutomaticTemperatureControl
    LOG_INF("Setting targetTemp via mqtt");
    float num_float = ::atof(strPayload.c_str());
    LOG_INF("new targetTemp: %.2f", num_float);
    updatePWM_MQTT_Screen_withNewTargetTemperature(num_float, true);
#else
    LOG_INF(
        "\"#define useAutomaticTemperatureControl\" is NOT used in config.h "
        "Cannot set target temperature. Please set fan pwm.");
    updatePWM_MQTT_Screen_withNewTargetTemperature(getTargetTemperature(),
                                                   true);
#endif
  } else if (!strcmp(topic, MQTTCMNDACTUALTEMP)) {
#if defined(useAutomaticTemperatureControl) && \
    defined(setActualTemperatureViaMQTT)
    LOG_INF("Setting actualTemp via mqtt");
    float num_float = ::atoi(strPayload.c_str());
    LOG_INF("new actualTemp: %.2f", num_float);
    updatePWM_MQTT_Screen_withNewActualTemperature(num_float, true);
#else
    LOG_INF(
        "\"#define setActualTemperatureViaMQTT\" is NOT used in config.h  "
        "Cannot set actual temperature. Please use BME280.");
    updatePWM_MQTT_Screen_withNewActualTemperature(getActualTemperature(),
                                                   true);
#endif
  } else if (!strcmp(topic, MQTTCMNDFANPWM)) {
#ifndef useAutomaticTemperatureControl
    LOG_INF("Setting fan pwm via mqtt");
    int num_int = atoi(payload);
    LOG_INF("new fan pwm: %d", num_int);
    updateMQTT_Screen_withNewPWMvalue(num_int, true);
#else
    LOG_INF(
        "\"#define useAutomaticTemperatureControl\" is used in config.h  "
        "Cannot set fan pwm. Please set target temperature.");
    updateMQTT_Screen_withNewPWMvalue(getPWMvalue(), true);
#endif
  } else if (!strcmp(topic, MQTTCMNDFANMODE)) {
    LOG_INF("Setting HVAC mode from HA received via mqtt");
    if (!strcmp(payload, MQTTFANMODEFANONLYPAYLOAD)) {
      LOG_INF("  Will turn fan into \"fan_only\" mode");
      updateMQTT_Screen_withNewMode(false, true);
    } else if (!strcmp(payload, MQTTFANMODEOFFPAYLOAD)) {
      LOG_INF("  Will switch fan off");
      updateMQTT_Screen_withNewMode(true, true);
    } else {
      LOG_INF("Payload %s not supported", payload);
    }
#if defined(useOTAUpdate)
  } else if (topicReceived == topicCmndOTA) {
    if (strPayload == "ON") {
      LOG_INF("MQTT command TURN ON OTA received");
      ArduinoOTA.begin();
    } else if (strPayload == "OFF") {
      LOG_INF("MQTT command TURN OFF OTA received");
      ArduinoOTA.end();
    } else {
      LOG_INF("Payload %s not supported", payload);
    }
#endif
#if defined(useHomeassistantMQTTDiscovery)
  } else if (!strcmp(topic, HASSSTATUSTOPIC)) {
    if (!strcmp(payload, HASSSTATUSONLINEPAYLOAD)) {
      LOG_INF(
          "HA status online received. This means HA has restarted. Will send "
          "discovery again in some seconds as defined in config.h");
      // set timer so that discovery will be resent after some seconds (as
      // defined in config.h)
      timerStartForHAdiscovery = millis();
      // Very unlikely. Can only happen if millis() overflowed max unsigned
      // long every approx. 50 days
      if (timerStartForHAdiscovery == 0) {
        timerStartForHAdiscovery = 1;
      }
    } else if (!strcmp(payload, HASSSTATUSOFFLINEPAYLOAD)) {
      LOG_INF(
          "HA status offline received. Nice to know. Currently we don't "
          "react "
          "to this.");
    } else {
      LOG_INF("Payload %s not supported", payload);
    }
#endif
  }
}
#endif
```

## src/mqtt_helper.h
```c
#include <net/mqtt.h>
#include <net/socket.h>
#include <zephyr.h>

#include "config.h"

/* Buffers for MQTT client. */
static u8_t rx_buffer[APP_MQTT_BUFFER_SIZE];
static u8_t tx_buffer[APP_MQTT_BUFFER_SIZE];

static char packet[51];
static char topic[25];

/* The mqtt client struct */
#ifdef useHomeassistantMQTTDiscovery
static struct mqtt_topic will_topic_qos_0 = {
    .qos = 0,
    .topic.utf8 = HASSFANSTATUSTOPIC,
    .topic.size = sizeof(HASSFANSTATUSTOPIC) - 1};

static struct mqtt_utf8 will_msg = {
    .utf8 = HASSSTATUSOFFLINEPAYLOAD,
    .size = sizeof(HASSSTATUSOFFLINEPAYLOAD) - 1};

static struct mqtt_client client_ctx = {.will_retain = 1,
                                        .will_topic = &will_topic_qos_0,
                                        .will_message = &will_msg,
                                        .user_name = NULL,
                                        .password = NULL};
#else
static struct mqtt_client client_ctx;
#endif

/* MQTT Broker details. */
static struct sockaddr_storage broker;
#if defined(CONFIG_MQTT_LIB_SOCKS)
static struct sockaddr_storage socks5_proxy;
#endif

static struct pollfd fds[1];
static int nfds;

static bool connected;

// 0 will cause failure
static int current_msg_id = 1;

static struct mqtt_topic subs_topic;
static struct mqtt_subscription_list subs_list;

#define SUCCESS_OR_EXIT(rc) \
  {                         \
    if (rc != 0) {          \
      return;               \
    }                       \
  }
#define SUCCESS_OR_BREAK(rc) \
  {                          \
    if (rc != 0) {           \
      break;                 \
    }                        \
  }
#define RC_STR(rc) ((rc) == 0 ? "OK" : "ERROR")

#define PRINT_RESULT(func, rc) \
  printk("[%s:%d] %s: %d <%s>\n", __func__, __LINE__, (func), rc, RC_STR(rc))

static void broker_init(void);
static void client_init(struct mqtt_client *client);
static int process_mqtt_and_sleep(struct mqtt_client *client, int timeout);
static void mqtt_evt_handler(struct mqtt_client *const client,
                             const struct mqtt_evt *evt);

#ifdef useMQTT
bool publishMQTTMessage(const char *topic, const char *payload);
bool checkMQTTconnection();
void mqtt_setup(void);
void mqtt_loop(void);
bool mqtt_publish_tele(void);
bool mqtt_publish_stat_targetTemp();
bool mqtt_publish_stat_actualTemp();
bool mqtt_publish_stat_fanPWM();
bool mqtt_publish_stat_mode();
#ifdef useShutdownButton
bool mqtt_publish_shutdown();
#endif
#ifdef useHomeassistantMQTTDiscovery
/* Sets the start of the timer until HA discovery is sent.
   It will be waited WAITAFTERHAISONLINEUNTILDISCOVERYWILLBESENT ms before the
   discovery is sent. 0: discovery will not be sent >0: discovery will be sent
   as soon as "WAITAFTERHAISONLINEUNTILDISCOVERYWILLBESENT" ms are over
*/
extern unsigned long timerStartForHAdiscovery;
bool mqtt_publish_hass_discovery();

// itoa function
char *itoa(int num, char *str, int radix);
#endif
#endif
```

## src/oldmain.c
```c
// #include <Arduino.h>

#include "config.h"
#include "mqtt_helper.h"
#include "sensorBME280.h"
#include "fanPWM.h"
#include "fanTacho.h"
#include "temperatureController.h"
#include "tft.h"
#include "tftTouch.h"
#include <logging/log.h>
LOG_MODULE_DECLARE(fan_controller, LOG_LEVEL_DBG);

#if defined(useOTAUpdate)
  // https://github.com/SensorsIot/ESP32-OTA
  #include "OTA.h"
  #if !defined(useOTA_RTOS)
    #include <ArduinoOTA.h>
  #endif
#endif
#if defined(useTelnetStream)
#include "TelnetStream.h"
#endif

unsigned long previousMillis1000Cycle = 0;
unsigned long interval1000Cycle = 1000;
unsigned long previousMillis10000Cycle = 0;
unsigned long interval10000Cycle = 10000;

void setup(){
  // Serial.begin(115200);
  // Serial.println("");
  LOG_INF("Setting things up ...\r\n");

  #ifdef useWIFI
  wifi_setup();
  wifi_enable();
  #endif
  #if defined(useOTAUpdate)
  OTA_setup("ESP32fancontroller");
  // Do not start OTA. Save heap space and start it via MQTT only when needed.
  // ArduinoOTA.begin();
  #endif
  #if defined(useTelnetStream)
  TelnetStream.begin();
  #endif
  #ifdef useTFT
  initTFT();
  #endif
  #ifdef useTouch
  initTFTtouch();
  #endif
  initPWMfan();
  initTacho();
  #ifdef useTemperatureSensorBME280
  initBME280();
  #endif
  #ifdef useAutomaticTemperatureControl
  initTemperatureController();
  #endif
  #ifdef useMQTT
  mqtt_setup();
  #endif

  LOG_INF("Settings done. Have fun.\r\n");
}

void loop(){
  // functions that shall be called as often as possible
  // these functions should take care on their own that they don't nee too much time
  updateTacho();
  #ifdef useTouch
  processUserInput();
  #endif
  #if defined(useOTAUpdate) && !defined(useOTA_RTOS)
  // If you do not use FreeRTOS, you have to regulary call the handle method
  ArduinoOTA.handle();
  #endif
  // mqtt_loop() is doing mqtt keepAlive, processes incoming messages and hence triggers callback
  #ifdef useMQTT
  mqtt_loop();
  #endif

  unsigned long currentMillis = millis();

  // functions that shall be called every 1000 ms
  if ((currentMillis - previousMillis1000Cycle) >= interval1000Cycle) {
    previousMillis1000Cycle = currentMillis;

    #ifdef useTemperatureSensorBME280
    updateBME280();
    #endif
    #ifdef useAutomaticTemperatureControl
    setFanPWMbasedOnTemperature();
    #endif
    #ifdef useTFT
    draw_screen();
    #endif
    #ifdef useHomeassistantMQTTDiscovery
    if (((currentMillis - timerStartForHAdiscovery) >= WAITAFTERHAISONLINEUNTILDISCOVERYWILLBESENT) && (timerStartForHAdiscovery != 0)) {
      mqtt_publish_hass_discovery();
    }
    #endif
  }

  // functions that shall be called every 10000 ms
  if ((currentMillis - previousMillis10000Cycle) >= interval10000Cycle) {
    previousMillis10000Cycle = currentMillis;

    #ifdef useMQTT
    mqtt_publish_tele();
    #endif
    // doLog();
  }
}
```

## src/sensorBME280.c
```c
// #include <Adafruit_Sensor.h>
// #include <Adafruit_BME280.h>
#include "config.h"
#include "temperatureController.h"
#include <logging/log.h>
LOG_MODULE_DECLARE(fan_controller, LOG_LEVEL_DBG);

#ifdef useTemperatureSensorBME280
// Standard pressure at sea level. Will be calibrated in initBME280
float calibratedPressureAtSeaLevel = 1013.25;

float lastTempSensorValues[4];

Adafruit_BME280 bme;

TwoWire I2Cone = TwoWire(0);
bool status_BME280 = 0;
#endif

void initBME280(void){
  #ifdef useTemperatureSensorBME280
  lastTempSensorValues[0] = NAN;
  lastTempSensorValues[1] = NAN;
  lastTempSensorValues[2] = NAN;
  lastTempSensorValues[3] = NAN;

  I2Cone.begin(I2C_SDA, I2C_SCL, I2C_FREQ);
  status_BME280 = bme.begin(BME280_ADDR, &I2Cone);

  if (!status_BME280) {
    Log.printf("  Could not find a valid BME280 sensor, check wiring!\r\n");
  } else {
    Log.printf("  BME280 sucessfully initialized.\r\n");
    // Calibrate BME280 with actual pressure and given height. Will be used until restart of ESP32
    calibratedPressureAtSeaLevel = (bme.seaLevelForAltitude(HEIGHTOVERSEALEVELATYOURLOCATION, bme.readPressure() / 100.0F));
    Log.printf("  BME280 was calibrated to %.1f m\r\n", HEIGHTOVERSEALEVELATYOURLOCATION);
  }
  #else
  LOG_INF("    BME280 is disabled in config.h");
  #endif
}

void updateBME280(void){
  #ifdef useTemperatureSensorBME280
  if (!status_BME280){
    Log.printf("BME280 sensor not initialized, trying again ...\r\n");
    initBME280();
    if (status_BME280){
      Log.printf("success!\r\n");
    } else {
      lastTempSensorValues[0] = NAN;
      #ifndef setActualTemperatureViaMQTT
      setActualTemperatureAndPublishMQTT(lastTempSensorValues[0]);
      #endif
      lastTempSensorValues[1] = NAN;
      lastTempSensorValues[2] = NAN;
      lastTempSensorValues[3] = NAN;
      return;
    }
  }
  lastTempSensorValues[0] = bme.readTemperature();
  #ifndef setActualTemperatureViaMQTT
  setActualTemperatureAndPublishMQTT(lastTempSensorValues[0]);
  #endif
  lastTempSensorValues[1] = bme.readPressure() / 100.0F;
  lastTempSensorValues[2] = bme.readAltitude(calibratedPressureAtSeaLevel);
  lastTempSensorValues[3] = bme.readHumidity();
  #endif
}
```

## src/temperatureController.c
```c
// #include <Arduino.h>
// #include <esp32-hal-log.h>
#include "config.h"
#include "fanPWM.h"
#include "mqtt_helper.h"
#include "sensorBME280.h"
#include "tft.h"
#include <logging/log.h>
LOG_MODULE_DECLARE(fan_controller, LOG_LEVEL_DBG);

float targetTemperature;
float actualTemperature;
void setActualTemperatureAndPublishMQTT(float aActualTemperature) {
  if (actualTemperature != aActualTemperature) {
    actualTemperature = aActualTemperature;
    #ifdef useMQTT
    mqtt_publish_stat_actualTemp();
    #endif
  }
}

void updatePWM_MQTT_Screen_withNewTargetTemperature(float aTargetTemperature, bool force);
void updatePWM_MQTT_Screen_withNewActualTemperature(float aActualTemperature, bool force);

void initTemperatureController(void) {
  #ifdef useAutomaticTemperatureControl
  targetTemperature = INITIALTARGETTEMPERATURE;
  updatePWM_MQTT_Screen_withNewTargetTemperature(targetTemperature, true);
  #ifdef setActualTemperatureViaMQTT
  setActualTemperatureAndPublishMQTT(NAN);
  updatePWM_MQTT_Screen_withNewActualTemperature(actualTemperature, true);
  #endif

  #else
  LOG_INF("    Temperature control is disabled in config.h");
  #endif
}

float getTargetTemperature(void) {
  return targetTemperature;
}
float getActualTemperature(void) {
  return actualTemperature;
}

void setFanPWMbasedOnTemperature(void) {
  #ifdef useAutomaticTemperatureControl
  float difftemp = getActualTemperature() - targetTemperature;
  int newPWMvalue = 255;

  if ((getActualTemperature() == NAN) || (getActualTemperature() <= 0.0)){
    Log.printf("WARNING: no temperature value available. Cannot do temperature control. Will set PWM fan to 255.\r\n");
    newPWMvalue = 255;
  } else if (difftemp <= 0.0) {
    // Temperature is below target temperature. Run fan at minimum speed.
    newPWMvalue = PWMMINIMUMVALUE; 
  } else if (difftemp <= 0.5) {
    newPWMvalue = 140;
  } else if (difftemp <= 1.0) {
    newPWMvalue = 160;
  } else if (difftemp <= 1.5) {
    newPWMvalue = 180;
  } else if (difftemp <= 2.0) {
    newPWMvalue = 200;
  } else if (difftemp <= 2.5) {
    newPWMvalue = 220;
  } else if (difftemp <= 3.0) {
    newPWMvalue = 240;
  } else {
    // Temperature much too high. Run fan at full speed.
    newPWMvalue = 255;
  }
  
  // Log.printf("difftemp = %.2\r\n", difftemp);
  // Log.printf("newPWMvalue = %d\r\n", newPWMvalue);

  updateMQTT_Screen_withNewPWMvalue(newPWMvalue, false);
  #endif
}

void updatePWM_MQTT_Screen_withNewTargetTemperature(float aTargetTemperature, bool force) {
  if ((targetTemperature != aTargetTemperature) || force) {
    targetTemperature = aTargetTemperature;
    setFanPWMbasedOnTemperature();
    #ifdef useMQTT
    mqtt_publish_stat_targetTemp();
    #endif
    draw_screen();
  }
}

void updatePWM_MQTT_Screen_withNewActualTemperature(float aActualTemperature, bool force) {
  if ((actualTemperature != aActualTemperature) || force) {
    actualTemperature = aActualTemperature;
    setFanPWMbasedOnTemperature();
    #ifdef useMQTT
    mqtt_publish_stat_actualTemp();
    #endif
    draw_screen();
  }
}
```

## src/temperatureController.h
```c
#include <stdbool.h>

void initTemperatureController(void);
void setFanPWMbasedOnTemperature(void);
float getTargetTemperature(void);
float getActualTemperature(void);
void setActualTemperatureAndPublishMQTT(float aActualTemperature);
void updatePWM_MQTT_Screen_withNewTargetTemperature(float aTargetTemperature, bool force);
void updatePWM_MQTT_Screen_withNewActualTemperature(float aActualTemperature, bool force);
```
